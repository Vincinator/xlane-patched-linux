## drivers/asgard_drv/Kconfig
```kconfig
#
# Asgard Connection subsystem configuration
#

menuconfig ASGARD_DRV
	bool "Enable ASGARD_DRV"
	default y
	help
	  This enables ASGARD_DRV to use supported network cards.

	  Asgard Driver is required to run the Asgard Module
```

## drivers/asgarddrv/Kconfig
```kconfig
# ASGARD Driver 

config ASGARD_DRV
	bool "Enables the ASGARD Driver"
	default y
```

## net/asgard_drv/Kconfig
```kconfig
#
# Asgard Connection subsystem configuration
#

menuconfig ASGARD_DRV
	bool "Enable ASGARD_DRV"
	default y
	help
	  This enables ASGARD_DRV to use supported network cards.

	  Asgard Driver is required to run the Asgard Module

config ASGARD_MODULE
	tristate "Enable Asgard Module"
	default m
	depends on ASGARD_DRV
	---help---
	Asgard module includes the pacemaker, raft and a failure detector.

	Also requires the asgard module sources.
```
